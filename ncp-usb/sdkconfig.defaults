## ncp-usb/sdkconfig.defaults
```kconfig
# Reduce bootloader log verbosity
CONFIG_BOOTLOADER_LOG_LEVEL_WARN=y
CONFIG_BOOTLOADER_LOG_LEVEL=2

# Increase main task stack size
CONFIG_ESP_MAIN_TASK_STACK_SIZE=7168

# Enable filesystem
CONFIG_PARTITION_TABLE_CUSTOM=y
CONFIG_PARTITION_TABLE_CUSTOM_FILENAME="partitions.csv"
CONFIG_PARTITION_TABLE_FILENAME="partitions.csv"

# Enable FreeRTOS stats formatting functions, needed for 'tasks' command
CONFIG_FREERTOS_USE_TRACE_FACILITY=y
CONFIG_FREERTOS_USE_STATS_FORMATTING_FUNCTIONS=y

# Zigbee
CONFIG_ZB_ENABLED=y
CONFIG_ZB_ZCZR=y

# NCP bus mode: USB Serial/JTAG (standalone — plug directly into PC)
CONFIG_NCP_BUS_MODE_USB=y

# Console output via UART0 (since USB is used for NCP data)
CONFIG_ESP_CONSOLE_UART_DEFAULT=y
```
